/*
 * Copyright 2020 Digi International Inc.
 *
 * Permission to use, copy, modify, and/or distribute this software for any
 * purpose with or without fee is hereby granted, provided that the above
 * copyright notice and this permission notice appear in all copies.
 * THE SOFTWARE IS PROVIDED "AS IS" AND THE AUTHOR DISCLAIMS ALL WARRANTIES
 * WITH REGARD TO THIS SOFTWARE INCLUDING ALL IMPLIED WARRANTIES OF
 * MERCHANTABILITY AND FITNESS. IN NO EVENT SHALL THE AUTHOR BE LIABLE FOR
 * ANY SPECIAL, DIRECT, INDIRECT, OR CONSEQUENTIAL DAMAGES OR ANY DAMAGES
 * WHATSOEVER RESULTING FROM LOSS OF USE, DATA OR PROFITS, WHETHER IN AN
 * ACTION OF CONTRACT, NEGLIGENCE OR OTHER TORTIOUS ACTION, ARISING OUT OF
 * OR IN CONNECTION WITH THE USE OR PERFORMANCE OF THIS SOFTWARE.
 */

#include <dt-bindings/gpio/gpio.h>

/dts-v1/;
/plugin/;

/ {
	fragment@0 {
		target-path = "/";
		__overlay__ {
			overlay-description = "SBC: PCIe (mini card)";
		};
	};

	/* Enable the PCIe regulator */
	fragment@1 {
		target = <&reg_3v3_pcie>;
		__overlay__ {
			status = "okay";
		};
	};

	/*
	 * Enable PCIe (mini card):
	 * - Add the 3V3 PCIe regulator as a supply
	 * - Use the regulator and mini card pinctrls
	 * - Change the reset GPIO and add the disable GPIO
	 */
	fragment@2 {
		target = <&pcieb>;
		__overlay__ {
			pinctrl-names = "default", "sleep";
			pinctrl-0 = <&pinctrl_reg_3v3_pcie>, <&pinctrl_pcieb_mini_card>;
			pinctrl-1 = <&pinctrl_reg_3v3_pcie_sleep>;
			reset-gpio = <&lsio_gpio4 21 GPIO_ACTIVE_LOW>; 	/* PCIE_RESET_N --> changed from GPIO3_16 to GPIO4_21 !! */
			disable-gpio = <&lsio_gpio2 0 GPIO_ACTIVE_HIGH>; 	/* PCIE_DIS_N --> changed from GPIO0_30 to GPIO2_00 !! */
			//wake-gpio = <&lsio_gpio0 1 GPIO_ACTIVE_LOW>; 		/* PCIE_WAKE_N --> GPIO0_01 (>2sec LOW-pulse for Telit LE910C !!) NOTE: not controlled by driver! Using (userspace-)script instead to toggle GPIO!! */
			vpcie-supply = <&reg_3v3_pcie>;		
			status = "okay";
		};
	};
};
